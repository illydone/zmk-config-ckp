## config/boards/arm/bt65/Kconfig
```kconfig
# SPDX-License-Identifier: MIT

config BOARD_ENABLE_DCDC
	bool "Enable DCDC mode"
	select SOC_DCDC_NRF52X
	default y
	depends on BOARD_BT65

ZMK_BACKLIGHT_BRT_STEP=10
ZMK_BACKLIGHT_BRT_START=10
ZMK_BACKLIGHT_ON_START=n
ZMK_BACKLIGHT_AUTO_OFF_IDLE=y
ZMK_BACKLIGHT_AUTO_OFF_USB=n

ZMK_RGB_UNDERGLOW_ON_START=n
ZMK_RGB_UNDERGLOW_AUTO_OFF_IDLE=y

CONFIG_ZMK_SLEEP=y
CONFIG_ZMK_MOUSE=y
```
